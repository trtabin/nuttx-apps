## examples/myapp/Kconfig
```kconfig
#
# For a description of the syntax of this configuration file,
# see the file kconfig-language.txt in the NuttX tools repository.
#

config EXAMPLES_MYAPP
    bool "MyApp example"
    default y
    ---help---
        Enable a simple custom example app.
```
